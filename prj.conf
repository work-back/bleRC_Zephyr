## CMakeLists.txt
```
# SPDX-License-Identifier: Apache-2.0

cmake_minimum_required(VERSION 3.20.0)
find_package(Zephyr REQUIRED HINTS $ENV{ZEPHYR_BASE})
project(szpi)

FILE(GLOB app_sources src/*.c)
target_sources(app PRIVATE
  ${app_sources}
  )
```

## sample.yaml
```
sample:
  name: SZPI
  description: SZPI
common:
  min_ram: 2
  min_flash: 16
  tags: introduction
  integration_platforms:
    - native_sim
  harness: console
tests:
  sample.bluetooth.szpi:
    harness: bluetooth
  sample.bluetooth.szpi.no_authentication:
    harness: bluetooth
    extra_configs:
      - CONFIG_SAMPLE_BT_USE_AUTHENTICATION=n
    tags: bluetooth
```

## prj.conf
```kconfig
# General Config
CONFIG_MAIN_STACK_SIZE=10240
CONFIG_CONSOLE=y
CONFIG_LOG=y
CONFIG_SHELL=y

# Device Config
CONFIG_GPIO=y
CONFIG_I2C=y
CONFIG_SPI=y
CONFIG_INPUT=y
CONFIG_DMA=y 

# SPI CS delay depends on PCA9557 IO
CONFIG_GPIO_PCA_SERIES_INIT_PRIORITY=55
CONFIG_SPI_INIT_PRIORITY=56 

# Display Config
CONFIG_DISPLAY=y
CONFIG_DISPLAY_LOG_LEVEL_ERR=y

# LVGL Config
# 16KB
CONFIG_LV_Z_MEM_POOL_SIZE=16384 
CONFIG_LV_Z_POINTER_INPUT=y
CONFIG_LV_Z_SHELL=y
CONFIG_LVGL=y
CONFIG_LV_USE_LOG=y
CONFIG_LV_USE_LABEL=y
CONFIG_LV_USE_ARC=y
CONFIG_LV_USE_MONKEY=y
CONFIG_LV_FONT_MONTSERRAT_14=y
# 16-bit color depth RGB565
CONFIG_LV_COLOR_DEPTH_16=y      
CONFIG_LV_COLOR_16_SWAP=y 
CONFIG_LV_USE_SYSMON=y
CONFIG_LV_USE_PERF_MONITOR=y
```

## boards/esp32s3_devkitc_esp32s3_procpu.overlay
```dts
&flash0 {
    reg = <0x0 DT_SIZE_M(16)>;
};
```

## src/main.c
```c
/*
 * Copyright (c) 2018 Jan Van Winkel <jan.van_winkel@dxplore.eu>
 *
 * SPDX-License-Identifier: Apache-2.0
 */

#include <zephyr/device.h>
#include <zephyr/devicetree.h>
#include <zephyr/drivers/display.h>
#include <zephyr/drivers/gpio.h>
#include <lvgl.h>
#include <stdio.h>
#include <string.h>
#include <zephyr/kernel.h>
#include <lvgl_input_device.h>

#define LOG_LEVEL CONFIG_LOG_DEFAULT_LEVEL
#include <zephyr/logging/log.h>
LOG_MODULE_REGISTER(app);

static uint32_t count;
static const struct gpio_dt_spec backlight = GPIO_DT_SPEC_GET(DT_ALIAS(backlight), gpios);

#ifdef CONFIG_GPIO
static struct gpio_dt_spec button_gpio = GPIO_DT_SPEC_GET_OR(DT_ALIAS(sw0), gpios, {0});
static struct gpio_callback button_callback;
static void button_isr_callback(const struct device *port, struct gpio_callback *cb, uint32_t pins)
{
	ARG_UNUSED(port);
	ARG_UNUSED(cb);
	ARG_UNUSED(pins);
	count = 0;
}
#endif /* CONFIG_GPIO */

#ifdef CONFIG_LV_Z_ENCODER_INPUT
static const struct device *lvgl_encoder =
	DEVICE_DT_GET(DT_COMPAT_GET_ANY_STATUS_OKAY(zephyr_lvgl_encoder_input));
#endif /* CONFIG_LV_Z_ENCODER_INPUT */

#ifdef CONFIG_LV_Z_KEYPAD_INPUT
static const struct device *lvgl_keypad =
	DEVICE_DT_GET(DT_COMPAT_GET_ANY_STATUS_OKAY(zephyr_lvgl_keypad_input));
#endif /* CONFIG_LV_Z_KEYPAD_INPUT */

static void lv_btn_click_callback(lv_event_t *e)
{
	ARG_UNUSED(e);
	count = 0;
}

int main(void)
{
	static char count_str[11] = {0};
	const struct device *display_dev;
	lv_obj_t *hello_world_label;
	lv_obj_t *count_label;

	display_dev = DEVICE_DT_GET(DT_CHOSEN(zephyr_display));
	if (!device_is_ready(display_dev)) {
		LOG_ERR("Device not ready, aborting test");
		return 0;
	}

	lv_obj_t *hello_world_button;
	hello_world_button = lv_button_create(lv_screen_active());
	lv_obj_align(hello_world_button, LV_ALIGN_CENTER, 0, -15);
	lv_obj_add_event_cb(hello_world_button, lv_btn_click_callback, LV_EVENT_CLICKED,
				NULL);
	hello_world_label = lv_label_create(hello_world_button);
	lv_label_set_text(hello_world_label, "Hello world!");
	lv_obj_align(hello_world_label, LV_ALIGN_CENTER, 0, 0);

	count_label = lv_label_create(lv_screen_active());
	lv_obj_align(count_label, LV_ALIGN_BOTTOM_MID, 0, 0);

    gpio_pin_configure_dt(&backlight, GPIO_OUTPUT);
	gpio_pin_set(backlight.port, backlight.pin, 1);

	display_blanking_off(display_dev);
    lv_timer_handler();

	while (1) {
		if ((count % 100) == 0U) {
			sprintf(count_str, "%d", count/100U);
			lv_label_set_text(count_label, count_str);
		}
		lv_timer_handler();
		++count;
		k_sleep(K_MSEC(10));
	}
}
```
